/* Generated by gen_pairing_oracle.py — do not edit. */
static const char oracle_server_pem[] =
"-----BEGIN CERTIFICATE-----\nMIIDFTCCAf2gAwIBAgIUNti0KilV6NxR"
"tkM5Mfw1Y7UGMJQwDQYJKoZIhvcNAQEL\nBQAwGjEYMBYGA1UEAwwPZmFrZS1"
"hdHYtc2VydmVyMB4XDTI2MDcxOTE3MDQxNVoX\nDTI3MDcxOTE3MDQxNVowGj"
"EYMBYGA1UEAwwPZmFrZS1hdHYtc2VydmVyMIIBIjAN\nBgkqhkiG9w0BAQEFA"
"AOCAQ8AMIIBCgKCAQEAuTvP6sQ7cNseBI3rKS+L4hp838P8\n3tTKvDO6rW1Q"
"7Ztb902LYFkMeGZ2iBGlWaA9wvcEXhKq1lp4lcXReRm+UGvGxR+n\nVkWc9Hm"
"xivdtnsm4Ee9Jj46aWnJwJy1rDrCzkSqV4JcrfqEypWIOBXp7tFH1RYsN\n1n"
"fpedwkGvVdoaDaAxqtG/ZbZaySX3L+b4S9df14CS96SyHZqMZumF8aMn24qE"
"bY\nTJqlrux1pOSTEV1ZGgKR5GAKs2g/S6VS4vhF8esCnjo567ZzR4kZIULk1"
"UV+Yjp/\ntVpzvh8JKF1gyDBmOW+2OJIgVhdFhSwofCIKCAfwHm8ICqYIet5F"
"vU2voQIDAQAB\no1MwUTAdBgNVHQ4EFgQU0/yeQ6Nja1f9MQhFKmIPY1srolA"
"wHwYDVR0jBBgwFoAU\n0/yeQ6Nja1f9MQhFKmIPY1srolAwDwYDVR0TAQH/BA"
"UwAwEB/zANBgkqhkiG9w0B\nAQsFAAOCAQEAPYsd6KsAwdqgjAF4a5gexvGXx"
"OYwoEMq7X+IyQmI94F8t954a+9I\n/pWbFMTIBTB0vP6Wcj2t4yWc67xrnBNy"
"H6SesS2129J5fWA1LuL23FjJr2KN95Gh\n4t1p+ESEseLsVoIHj4qInOlAQ+l"
"1BD8NpZxHi70i66Z9axSIkstlVMI3D8lQ045j\nubZ6MNDiXz0zzObJRhWr3e"
"RjpjInMCdAg5UnSkxaFrZgU1WmgUIQ+t5bFvCt3y96\n5hFi/RQ+58BPIPBmS"
"T9kYVx/qoTBUhcD2bPrpQCWiEdfVFU0RK+7Pq4EC3AXw0gk\nF2Jde609HUFq"
"g+nlF+rH6j+DfIizbBN/cA==\n-----END CERTIFICATE-----\n"
;
static const char oracle_code[] = "2C42AF";
static const uint8_t oracle_secret[] = { 0x2c, 0xad, 0x14, 0xc0, 0x57, 0xf5, 0x08, 0x89, 0xed, 0xdc, 0x0a, 0xc4, 0xec, 0x97, 0xaa, 0xfc, 0x20, 0x18, 0xd5, 0x33, 0xaf, 0xc5, 0x13, 0x3f, 0xfa, 0x39, 0xdb, 0x72, 0x16, 0xa4, 0xb6, 0xe5 };
