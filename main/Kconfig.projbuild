## main/Kconfig.projbuild
```kconfig
menu "Android TV Remote"

    config ATV_WIFI_SSID
        string "WiFi SSID"
        default ""
        help
            SSID of the WiFi network the ESP32 should join.

    config ATV_WIFI_PASSWORD
        string "WiFi password"
        default ""
        help
            Password of the WiFi network (leave empty for open networks).

    config ATV_TV_IP
        string "Android TV / Chromecast IP address"
        default "192.168.0.104"
        help
            LAN IP of the TV. Pairing uses port 6467, control port 6466.
            (mDNS discovery is a later stretch goal.)

    config ATV_SAMSUNG_TV_IP
        string "Samsung TV IP address (optional, volume fallback)"
        default "192.168.0.74"
        help
            LAN IP of a Samsung Tizen TV to use as a volume-control
            fallback when the Chromecast reports it cannot control volume
            (remote_set_volume_level.volume_max == 0). Leave empty to
            disable this feature entirely. Uses the TV's local WebSocket
            remote API on port 8001.

endmenu
```

## sdkconfig.defaults
```kconfig
CONFIG_ESPTOOLPY_FLASHSIZE_4MB=y
CONFIG_LWIP_MAX_SOCKETS=16
# Samsung TV WebSocket fallback (samsung_tv.c) connects to the TV's
# self-signed cert on :8002 without a CA, same trust model net_tls.c
# already uses for the Chromecast.
CONFIG_ESP_TLS_INSECURE=y
CONFIG_ESP_TLS_SKIP_SERVER_CERT_VERIFY=y
```
